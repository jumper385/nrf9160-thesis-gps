## CMakeLists.txt
```
#-------------------------------------------------------------------------------
# Zephyr Example Application
#
# Copyright (c) 2021 Nordic Semiconductor ASA
# SPDX-License-Identifier: Apache-2.0

cmake_minimum_required(VERSION 3.13.1)
find_package(Zephyr REQUIRED HINTS $ENV{ZEPHYR_BASE})

project(app LANGUAGES C)

target_sources(app PRIVATE
  src/main.c
  src/gnss.c
  src/payload.c
  src/coap_client.c
)

# The code below locates the git index file for this repository and adds it as a dependency for
# the application VERSION file so that if the repo has a new commit added, even if no files in
# the build have changed, the application version file will be regenerated with the new git commit
find_package(Git QUIET)
if(GIT_FOUND)
  execute_process(
    COMMAND ${GIT_EXECUTABLE} rev-parse --absolute-git-dir
    WORKING_DIRECTORY .
    OUTPUT_VARIABLE application_git_dir
    OUTPUT_STRIP_TRAILING_WHITESPACE
    ERROR_STRIP_TRAILING_WHITESPACE
    ERROR_VARIABLE stderr
    RESULT_VARIABLE return_code
  )
  # If there is an error e.g. it is not a git repo, we just silently ignore it and continue
  # without a dependency, this will be the case with freestanding applications.
  if(NOT return_code)
    if(NOT "${stderr}" STREQUAL "")
      message(WARNING "Application build version git rev-parse warned: ${stderr}")
    endif()

    set_property(TARGET app_version_h PROPERTY APP_VERSION_DEPENDS ${application_git_dir}/index)
  endif()
endif()
```

## prj.conf
```kconfig
CONFIG_TFM_PROFILE_TYPE_MINIMAL=y
CONFIG_STDOUT_CONSOLE=y
CONFIG_UART_INTERRUPT_DRIVEN=y
CONFIG_LOG=y
CONFIG_LOG_MODE_IMMEDIATE=y

# TF-M (same as the GNSS sample)
CONFIG_TFM_PROFILE_TYPE_MINIMAL=y

# General
#CONFIG_TFM_ENABLE_CP10CP11=y
#CONFIG_FPU=y
CONFIG_PICOLIBC_IO_FLOAT=y
CONFIG_LOG=y
CONFIG_LOG_MODE_IMMEDIATE=y
CONFIG_STDOUT_CONSOLE=y
CONFIG_UART_INTERRUPT_DRIVEN=y

# Modem
CONFIG_NRF_MODEM_LIB=y

# LTE link control. The "_GPS" system mode is required, otherwise the modem
# refuses to activate GNSS. Use LTE_M_GPS or NBIOT_GPS to match your SIM/carrier.
CONFIG_LTE_LINK_CONTROL=y
CONFIG_LTE_NETWORK_MODE_LTE_M_GPS=y

# Networking: modem-offloaded sockets, no native stack
CONFIG_NETWORKING=y
CONFIG_NET_NATIVE=n
CONFIG_NET_SOCKETS=y
CONFIG_NET_SOCKETS_OFFLOAD=y

# CoAP packet library
CONFIG_COAP=y

# Memory
CONFIG_HEAP_MEM_POOL_SIZE=4096
CONFIG_MAIN_STACK_SIZE=4096
CONFIG_SYSTEM_WORKQUEUE_STACK_SIZE=2048

CONFIG_GPIO=y
```

## debug.conf
```kconfig
# Copyright (c) 2021 Nordic Semiconductor ASA
# SPDX-License-Identifier: Apache-2.0
#
# This is a Kconfig fragment which can be used to enable debug-related options
# in the application. See the README for more details.

# compiler
CONFIG_DEBUG_OPTIMIZATIONS=y

# logging
CONFIG_SERIAL=y
CONFIG_CONSOLE=y
CONFIG_UART_CONSOLE=y
CONFIG_PRINTK=y
CONFIG_LOG=y
CONFIG_APP_LOG_LEVEL_DBG=y
```

## src/main.c
```c
/*
 * GNSS fix -> CoAP POST, nRF9160 DK (nrf9160dk/nrf9160/ns)
 *
 * A periodic timer drives the reporting cycle:
 *   1. LTE off, GNSS on, wait for a valid fix        (gnss.c)
 *   2. Pack the fix into an 18-byte binary record     (payload.c)
 *   3. GNSS off, LTE on, POST the record to a CoAP
 *      server and wait for the ACK                    (coap_client.c)
 *   4. LTE off, wait for the next timer tick
 */

#include <modem/lte_lc.h>
#include <modem/nrf_modem_lib.h>
#include <zephyr/kernel.h>
#include <zephyr/logging/log.h>

#include "coap_client.h"
#include "gnss.h"
#include "payload.h"
#include <zephyr/drivers/gpio.h>

static const struct gpio_dt_spec led = GPIO_DT_SPEC_GET(DT_NODELABEL(led0), gpios);
static const struct gpio_dt_spec btn = GPIO_DT_SPEC_GET(DT_NODELABEL(button2), gpios);

LOG_MODULE_REGISTER(app, LOG_LEVEL_INF);

/* ---- Edit these ---------------------------------------------------------- */
#define REPORT_PERIOD_S 10 /* time between the start of reporting cycles */
/* -------------------------------------------------------------------------- */

/*
 * The cycle itself can block for minutes (waiting for a fix), so the timer
 * handler only wakes the main thread instead of doing the work in ISR
 * context. The semaphore has a count limit of 1: if a cycle runs longer
 * than the period, the next cycle starts immediately rather than piling up.
 */
static K_SEM_DEFINE(report_sem, 0, 1);

static void report_timer_handler(struct k_timer *timer) {
  ARG_UNUSED(timer);
  k_sem_give(&report_sem);
}

K_TIMER_DEFINE(report_timer, report_timer_handler, NULL);

static struct gpio_callback btn_cb_data;

/* One reporting cycle: get a fix and POST it. */
static void report_cycle(void) {

  int err;
  struct nrf_modem_gnss_pvt_data_frame fix;

  bool led_inhibit = gpio_pin_get_dt(&btn);

  if (!led_inhibit) {
    gpio_pin_set_dt(&led, 1);
  }

  err = gnss_get_fix(&fix);
  if (err) {
    LOG_WRN("No fix this cycle (%d)", err);
    return;
  }

  uint8_t payload[FIX_PAYLOAD_LEN];
  size_t len = pack_fix(payload, &fix);

  LOG_INF("Fix: lat %.6f lon %.6f acc %.1f m alt %.1f m "
          "%04u-%02u-%02uT%02u:%02u:%02uZ (%u-byte binary payload)",
          fix.latitude, fix.longitude, (double)fix.accuracy,
          (double)fix.altitude, fix.datetime.year, fix.datetime.month,
          fix.datetime.day, fix.datetime.hour, fix.datetime.minute,
          fix.datetime.seconds, (unsigned)len);

  LOG_INF("Connecting to LTE...");
  err = lte_lc_connect();
  if (err) {
    LOG_ERR("LTE connect failed: %d", err);
    return;
  }
  LOG_INF("LTE connected");

  err = coap_client_post(payload, len);
  if (err) {
    LOG_ERR("CoAP send failed: %d", err);
  }
  if (!led_inhibit) {
    gpio_pin_set_dt(&led, 0);
  }
}

int main(void) {
  int err;

  if (!device_is_ready(btn.port)) {
    LOG_ERR("Button device not ready");
    return -1;
  }
  gpio_pin_configure_dt(&btn, GPIO_INPUT);

  if (!device_is_ready(led.port)) {
    LOG_ERR("LED device not ready");
    return -1;
  }
  gpio_pin_configure_dt(&led, GPIO_OUTPUT_INACTIVE);

  LOG_INF("GNSS -> CoAP app starting");

  err = nrf_modem_lib_init();
  if (err) {
    LOG_ERR("Modem library init failed: %d", err);
    return err;
  }

  err = gnss_init();
  if (err) {
    LOG_ERR("GNSS init failed: %d", err);
    return err;
  }

  /* Fire immediately, then every REPORT_PERIOD_S. */
  k_timer_start(&report_timer, K_NO_WAIT, K_SECONDS(REPORT_PERIOD_S));

  for (;;) {
    k_sem_take(&report_sem, K_FOREVER);

    report_cycle();

    /* LTE off so GNSS can use the radio next cycle. */
    (void)lte_lc_func_mode_set(LTE_LC_FUNC_MODE_DEACTIVATE_LTE);
  }

  return 0;
}
```

## src/coap_client.c
```c
#include "coap_client.h"

#include <errno.h>
#include <string.h>
#include <zephyr/logging/log.h>
#include <zephyr/net/coap.h>
#include <zephyr/net/socket.h>

LOG_MODULE_REGISTER(coap_client, LOG_LEVEL_INF);

/* ---- Edit these ---------------------------------------------------------- */
#define COAP_SERVER_HOST "172.105.254.131"
#define COAP_SERVER_PORT "1183"
#define COAP_URI_PATH "location"
#define COAP_ACK_TIMEOUT_MS 10000
/* -------------------------------------------------------------------------- */

int coap_client_post(const uint8_t *payload, size_t payload_len) {
  int err;
  int fd = -1;
  struct zsock_addrinfo *res = NULL;
  struct zsock_addrinfo hints = {
      .ai_family = AF_INET,
      .ai_socktype = SOCK_DGRAM,
  };

  err = zsock_getaddrinfo(COAP_SERVER_HOST, COAP_SERVER_PORT, &hints, &res);
  if (err || res == NULL) {
    LOG_ERR("DNS lookup for %s failed: %d", COAP_SERVER_HOST, err);
    return -EHOSTUNREACH;
  }

  fd = zsock_socket(res->ai_family, SOCK_DGRAM, IPPROTO_UDP);
  if (fd < 0) {
    LOG_ERR("socket() failed: %d", errno);
    err = -errno;
    goto out;
  }

  if (zsock_connect(fd, res->ai_addr, res->ai_addrlen) < 0) {
    LOG_ERR("connect() failed: %d", errno);
    err = -errno;
    goto out;
  }

  /* Build the request. */
  uint8_t tx[256];
  struct coap_packet req;
  uint16_t msg_id = coap_next_id();
  uint8_t *token = coap_next_token();

  err = coap_packet_init(&req, tx, sizeof(tx), COAP_VERSION_1, COAP_TYPE_CON,
                         COAP_TOKEN_MAX_LEN, token, COAP_METHOD_POST, msg_id);
  if (err < 0) {
    LOG_ERR("coap_packet_init failed: %d", err);
    goto out;
  }

  err = coap_packet_append_option(&req, COAP_OPTION_URI_PATH, COAP_URI_PATH,
                                  strlen(COAP_URI_PATH));
  if (err < 0) {
    goto out;
  }

  err = coap_append_option_int(&req, COAP_OPTION_CONTENT_FORMAT,
                               COAP_CONTENT_FORMAT_APP_OCTET_STREAM);
  if (err < 0) {
    goto out;
  }

  err = coap_packet_append_payload_marker(&req);
  if (err < 0) {
    goto out;
  }

  err = coap_packet_append_payload(&req, payload, payload_len);
  if (err < 0) {
    LOG_ERR("Payload does not fit in buffer: %d", err);
    goto out;
  }

  if (zsock_send(fd, req.data, req.offset, 0) < 0) {
    LOG_ERR("send() failed: %d", errno);
    err = -errno;
    goto out;
  }
  LOG_INF("Sent CoAP POST /%s (%u bytes payload)", COAP_URI_PATH,
          (unsigned)payload_len);

  /* Wait for the ACK / piggybacked response. */
  struct zsock_pollfd pfd = {.fd = fd, .events = ZSOCK_POLLIN};

  if (zsock_poll(&pfd, 1, COAP_ACK_TIMEOUT_MS) <= 0) {
    LOG_WRN("No response from server within %d ms", COAP_ACK_TIMEOUT_MS);
    err = -ETIMEDOUT;
    goto out;
  }

  uint8_t rx[256];
  int n = zsock_recv(fd, rx, sizeof(rx), 0);

  if (n < 0) {
    LOG_ERR("recv() failed: %d", errno);
    err = -errno;
    goto out;
  }

  struct coap_packet reply;

  err = coap_packet_parse(&reply, rx, n, NULL, 0);
  if (err < 0) {
    LOG_ERR("Could not parse reply: %d", err);
    goto out;
  }

  uint8_t code = coap_header_get_code(&reply);

  LOG_INF("Server replied with CoAP code %u.%02u", code >> 5, code & 0x1f);
  err = 0;

out:
  if (fd >= 0) {
    zsock_close(fd);
  }
  if (res) {
    zsock_freeaddrinfo(res);
  }
  return err;
}
```

## src/coap_client.h
```c
/*
 * Minimal CoAP client: POST a binary payload to the configured server and
 * wait for the ACK / piggybacked response.
 */

#ifndef APP_COAP_CLIENT_H
#define APP_COAP_CLIENT_H

#include <stddef.h>
#include <stdint.h>

/*
 * POST `payload` to the configured CoAP server. Requires an active LTE
 * connection. Returns 0 if the server answered, negative errno otherwise.
 */
int coap_client_post(const uint8_t *payload, size_t payload_len);

#endif /* APP_COAP_CLIENT_H */
```

## src/gnss.c
```c
#include "gnss.h"

#include <modem/lte_lc.h>
#include <zephyr/kernel.h>
#include <zephyr/logging/log.h>

LOG_MODULE_REGISTER(gnss, LOG_LEVEL_INF);

/* ---- Edit these ---------------------------------------------------------- */
#define FIX_TIMEOUT_S 300 /* give up on a fix after this long */
/* -------------------------------------------------------------------------- */

static struct nrf_modem_gnss_pvt_data_frame pvt;
static K_SEM_DEFINE(pvt_sem, 0, 1);

static void gnss_event_handler(int event) {
  if (event == NRF_MODEM_GNSS_EVT_PVT) {
    if (nrf_modem_gnss_read(&pvt, sizeof(pvt), NRF_MODEM_GNSS_DATA_PVT) == 0) {
      k_sem_give(&pvt_sem);
    }
  }
}

int gnss_init(void) {
  int err = nrf_modem_gnss_event_handler_set(gnss_event_handler);

  if (err) {
    LOG_ERR("Failed to set GNSS handler: %d", err);
  }
  return err;
}

int gnss_get_fix(struct nrf_modem_gnss_pvt_data_frame *out) {
  int err;
  int64_t deadline = k_uptime_get() + (int64_t)FIX_TIMEOUT_S * 1000;

  /* GNSS can only be activated while LTE is off. */
  (void)lte_lc_func_mode_set(LTE_LC_FUNC_MODE_DEACTIVATE_LTE);

  err = lte_lc_func_mode_set(LTE_LC_FUNC_MODE_ACTIVATE_GNSS);
  if (err) {
    LOG_ERR("Activate GNSS failed: %d", err);
    return err;
  }

  /* Single-fix mode: fix_interval 0 means "one fix, then stop". */
  nrf_modem_gnss_fix_retry_set(0);
  nrf_modem_gnss_fix_interval_set(0);

  k_sem_reset(&pvt_sem);

  err = nrf_modem_gnss_start();
  if (err) {
    LOG_ERR("GNSS start failed: %d", err);
    return err;
  }

  LOG_INF("Searching for fix (timeout %d s)...", FIX_TIMEOUT_S);

  err = -ETIMEDOUT;
  while (k_uptime_get() < deadline) {
    if (k_sem_take(&pvt_sem, K_SECONDS(5)) != 0) {
      continue;
    }

    if (pvt.flags & NRF_MODEM_GNSS_PVT_FLAG_FIX_VALID) {
      *out = pvt;
      err = 0;
      break;
    }

    int tracked = 0, used = 0;

    for (int i = 0; i < NRF_MODEM_GNSS_MAX_SATELLITES; i++) {
      if (pvt.sv[i].sv > 0) {
        tracked++;
        if (pvt.sv[i].flags & NRF_MODEM_GNSS_SV_FLAG_USED_IN_FIX) {
          used++;
        }
      }
    }
    LOG_INF("No fix yet (tracking %d, using %d)", tracked, used);
  }

  nrf_modem_gnss_stop();
  (void)lte_lc_func_mode_set(LTE_LC_FUNC_MODE_DEACTIVATE_GNSS);

  return err;
}
```

## src/gnss.h
```c
/*
 * GNSS fix acquisition for the nRF9160 modem.
 */

#ifndef APP_GNSS_H
#define APP_GNSS_H

#include <nrf_modem_gnss.h>

/* Register the GNSS event handler. Call once after nrf_modem_lib_init(). */
int gnss_init(void);

/*
 * Blocks until a valid fix is written to `out` or the fix timeout expires.
 * Handles the LTE/GNSS radio arbitration (LTE off, GNSS on, then back off).
 * Returns 0 on success, negative errno otherwise.
 */
int gnss_get_fix(struct nrf_modem_gnss_pvt_data_frame *out);

#endif /* APP_GNSS_H */
```

## src/payload.c
```c
#include "payload.h"

#include <math.h>
#include <zephyr/sys/byteorder.h>

static int16_t clamp_i16(double v) {
  if (v > (double)INT16_MAX) {
    return INT16_MAX;
  }
  if (v < (double)INT16_MIN) {
    return INT16_MIN;
  }
  return (int16_t)lrint(v);
}

static uint16_t clamp_u16(double v) {
  if (v > (double)UINT16_MAX) {
    return UINT16_MAX;
  }
  if (v < 0.0) {
    return 0;
  }
  return (uint16_t)lrint(v);
}

size_t pack_fix(uint8_t *buf,
                const struct nrf_modem_gnss_pvt_data_frame *fix) {
  sys_put_le32((uint32_t)(int32_t)lrint(fix->latitude * 1e7), &buf[0]);
  sys_put_le32((uint32_t)(int32_t)lrint(fix->longitude * 1e7), &buf[4]);
  sys_put_le16((uint16_t)clamp_i16(fix->altitude * 10.0), &buf[8]);
  sys_put_le16(clamp_u16(fix->accuracy * 10.0), &buf[10]);
  buf[12] = (uint8_t)(fix->datetime.year - 2000);
  buf[13] = fix->datetime.month;
  buf[14] = fix->datetime.day;
  buf[15] = fix->datetime.hour;
  buf[16] = fix->datetime.minute;
  buf[17] = fix->datetime.seconds;
  return FIX_PAYLOAD_LEN;
}
```

## src/payload.h
```c
/*
 * Binary wire format for a fix report: 18 bytes, little-endian, no padding.
 *
 *   offset  size  field
 *   0       4     int32   latitude  in degrees * 1e7
 *   4       4     int32   longitude in degrees * 1e7
 *   8       2     int16   altitude  in decimetres (clamped to +/-3276.7 m)
 *   10      2     uint16  accuracy  in decimetres (clamped to 6553.5 m)
 *   12      1     uint8   year - 2000
 *   13      1     uint8   month
 *   14      1     uint8   day
 *   15      1     uint8   hour
 *   16      1     uint8   minute
 *   17      1     uint8   second
 *
 * All timestamp fields are UTC as reported by the modem.
 */

#ifndef APP_PAYLOAD_H
#define APP_PAYLOAD_H

#include <stddef.h>
#include <stdint.h>

#include <nrf_modem_gnss.h>

#define FIX_PAYLOAD_LEN 18

/* Serialize `fix` into `buf` (must hold at least FIX_PAYLOAD_LEN bytes).
 * Returns the number of bytes written. */
size_t pack_fix(uint8_t *buf, const struct nrf_modem_gnss_pvt_data_frame *fix);

#endif /* APP_PAYLOAD_H */
```
